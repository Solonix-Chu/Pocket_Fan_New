#include <stdio.h>
#include <string.h>
#include <stdlib.h>
#include <math.h>
#include <stdbool.h>

#include "freertos/FreeRTOS.h"
#include "freertos/task.h"
#include "esp_log.h"
#include "esp_timer.h"

#include "usr_lcd.h"
#include "app_button.h"
#include "ui.h"

#define SPEED 4
#define ICON_SPEED 12
#define ICON_SPACE 48

static const char *TAG = "ui";

static const uint8_t icon_pic[][200] =
    {
        {
            0x00, 0x00, 0x1C, 0x00, 0x00, 0x00, 0x00, 0x3E,
            0x00, 0x00, 0x00, 0x00, 0x7E, 0x00, 0x00, 0x00,
            0x00, 0x7E, 0x00, 0x00, 0x00, 0x00, 0x7F, 0x00,
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            0x00, 0x00, 0x00, 0x00, 0x00, 0x00, 0x00, /*"C:\Users\ROG\Desktop\三连\点赞.bmp",0*/
            /* (36 X 35 )*/
        },
        {
            0x00, 0x00, 0x00, 0x00, 0x00, 0x00, 0x00, 0x00,
            0x00, 0x00, 0x00, 0x00, 0x0E, 0x00, 0x00, 0x00,
            0x00, 0x1F, 0x00, 0x00, 0x00, 0x80, 0x1F, 0x00,
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            0x00, 0x00, 0x00, 0x00, 0x00, 0x00, 0x00, 0x00,
            0x00 /*"C:\Users\ROG\Desktop\三连\收藏.bmp",0*/
                 /* (36 X 37 )*/
        },
        {
            0x00, 0x00, 0x00, 0x00, 0x00, 0x00, 0x80, 0x1F,
            0x00, 0x00, 0x00, 0xF0, 0xFF, 0x01, 0x00, 0x00,
            0xFC, 0xFF, 0x07, 0x00, 0x00, 0xFF, 0xFF, 0x0F,
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            0x00, 0x00, 0x00, 0x00 /*"C:\Users\ROG\Desktop\三连\投币.bmp",0*/
                                  /* (36 X 36 )*/
        },
        {
            0x00, 0x00, 0x00, 0x00, 0x00, 0x00, 0x00, 0x00,
            0x00, 0x00, 0x00, 0x00, 0x00, 0x00, 0x00, 0x00,
            0x00, 0x0C, 0x00, 0x00, 0x00, 0x00, 0x1C, 0x00,
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            0x00, 0x00, 0x00, 0x00, /*"C:\Users\13944\Desktop\fenxiang.bmp",0*/
        },
};

static const uint8_t icon_width[] = {35, 37, 36, 36};

static const uint8_t LOGO[] =
{
0x00,0x00,0x00,0x00,0x00,0x00,0x00,0x00,0x00,0x00,0x00,0x00,0x00,0x00,0x00,0x00,
0x00,0x00,0x00,0x00,0x00,0x00,0x00,0x00,0x00,0x00,0x00,0x00,0x00,0x00,0x00,0x00,
0x00,0x00,0x00,0x00,0x00,0x00,0x00,0x00,0x00,0x00,0x00,0x00,0x00,0x00,0x00,0x00,
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0x00,0x00,0x00,0x00,0x00,0x00,0x00,0x00,0x00,0x00,0x00,0x00,0x00,0x00,0x00,0x00
};

static const float PID_MAX = 10.00; 
static float Kpid[3] = {9.97, 0.2, 0.01}; 

static uint8_t disappear_step = 1;

static float angle, angle_last;
static uint8_t chart_x;
static bool frame_is_drawed = false;

static uint8_t *buf_ptr;
static uint16_t buf_len;

static uint8_t x;
static int16_t y, y_trg;
static uint8_t line_y, line_y_trg;
static uint8_t box_width, box_width_trg;
static int16_t box_y, box_y_trg;
static int8_t ui_select;

static uint8_t pid_line_y, pid_line_y_trg;
static uint8_t pid_box_width, pid_box_width_trg;
static int16_t pid_box_y, pid_box_y_trg;
static int8_t pid_select;

static int16_t icon_x, icon_x_trg;
static int16_t app_y, app_y_trg;

static int8_t icon_select;

static uint8_t ui_index, ui_state;

enum
{
    M_LOGO,
    M_SELECT,
    M_PID,
    M_PID_EDIT,
    M_ICON,
    M_CHART,
    M_TEXT_EDIT,
    M_VIDEO,
    M_ABOUT,
};

enum
{
    S_NONE,
    S_DISAPPEAR,
    S_SWITCH,
    S_MENU_TO_MENU,
    S_MENU_TO_PIC,
    S_PIC_TO_MENU,
};

typedef struct
{
    char *select;
} SELECT_LIST;

static SELECT_LIST pid[] =
    {
        {"-Proportion"},
        {"-Integral"},
        {"-Derivative"},
        {"Return"},
};

static uint8_t pid_num = sizeof(pid) / sizeof(SELECT_LIST);

static SELECT_LIST list[] =
    {
        {"MainUI"},
        {"+PID Editor"},
        {"-Icon Test"},
        {"-Chart Test"},
        {"-Text Edit"},
        {"-Play Video"},
        {"{ About }"},
};

static uint8_t list_num = sizeof(list) / sizeof(SELECT_LIST);
static uint8_t single_line_length;
static uint8_t total_line_length;

static SELECT_LIST icon[] =
    {
        {"Likes"},
        {"Collection"},
        {"Slot"},
        {"Share"},
};

static char name[] = "Hello World ";
static const uint8_t name_len = 12;
static uint8_t edit_index = 0;
static bool edit_flag = false;
static uint8_t blink_flag;
static const uint8_t BLINK_SPEED = 16;

static uint8_t icon_num = sizeof(icon) / sizeof(SELECT_LIST);

// Forward declarations
void select_proc(void);
void logo_proc(void);
void pid_proc(void);
void icon_proc(void);
void chart_proc(void);
void text_edit_proc(void);
void pid_edit_proc(void);
void about_proc(void);
void chart_draw_frame();


static bool move(int16_t *a, int16_t *a_trg)
{
    if (*a < *a_trg)
    {
        *a += SPEED;
        if (*a > *a_trg)
            *a = *a_trg;
    }
    else if (*a > *a_trg)
    {
        *a -= SPEED;
        if (*a < *a_trg)
            *a = *a_trg;
    }
    else
    {
        return true;
    }
    return false;
}

static bool move_icon(int16_t *a, int16_t *a_trg)
{
    if (*a < *a_trg)
    {
        *a += ICON_SPEED;
        if (*a > *a_trg)
            *a = *a_trg;
    }
    else if (*a > *a_trg)
    {
        *a -= ICON_SPEED;
        if (*a < *a_trg)
            *a = *a_trg;
    }
    else
    {
        return true;
    }
    return false;
}

static bool move_width(uint8_t *a, uint8_t *a_trg, uint8_t current_select, bool is_up)
{
    if (*a < *a_trg)
    {
        uint8_t step = 16 / SPEED;
        uint8_t len;
        if (ui_index == M_SELECT)
        {
            len = abs(u8g2_GetStrWidth(&u8g2, list[current_select].select) - u8g2_GetStrWidth(&u8g2, list[is_up ? current_select + 1 : current_select - 1].select));
        }
        else if (ui_index == M_PID)
        {
            len = abs(u8g2_GetStrWidth(&u8g2, pid[current_select].select) - u8g2_GetStrWidth(&u8g2, pid[is_up ? current_select + 1 : current_select - 1].select));
        }
        else {
            len = 1;
        }
        uint8_t width_speed = ((len % step) == 0 ? (len / step) : (len / step + 1));
        *a += width_speed;
        if (*a > *a_trg)
            *a = *a_trg;
    }
    else if (*a > *a_trg)
    {
        uint8_t step = 16 / SPEED;
        uint8_t len;
        if (ui_index == M_SELECT)
        {
            len = abs(u8g2_GetStrWidth(&u8g2, list[current_select].select) - u8g2_GetStrWidth(&u8g2, list[is_up ? current_select + 1 : current_select - 1].select));
        }
        else if (ui_index == M_PID)
        {
            len = abs(u8g2_GetStrWidth(&u8g2, pid[current_select].select) - u8g2_GetStrWidth(&u8g2, pid[is_up ? current_select + 1 : current_select - 1].select));
        }
        else {
            len = 1;
        }
        uint8_t width_speed = ((len % step) == 0 ? (len / step) : (len / step + 1));
        *a -= width_speed;
        if (*a < *a_trg)
            *a = *a_trg;
    }
    else
    {
        return true;
    }
    return false;
}

static bool move_bar(uint8_t *a, uint8_t *a_trg)
{
    if (*a < *a_trg)
    {
        uint8_t step = 16 / SPEED;
        uint8_t width_speed = ((single_line_length % step) == 0 ? (single_line_length / step) : (single_line_length / step + 1));
        *a += width_speed;
        if (*a > *a_trg)
            *a = *a_trg;
    }
    else if (*a > *a_trg)
    {
        uint8_t step = 16 / SPEED;
        uint8_t width_speed = ((single_line_length % step) == 0 ? (single_line_length / step) : (single_line_length / step + 1));
        *a -= width_speed;
        if (*a < *a_trg)
            *a = *a_trg;
    }
    else
    {
        return true;
    }
    return false;
}

static void text_edit(bool dir, uint8_t index)
{
    if (!dir)
    {
        if (name[index] >= 'A' && name[index] <= 'Z')
        {
            if (name[index] == 'A')
            {
                name[index] = 'z';
            }
            else
            {
                name[index] -= 1;
            }
        }
        else if (name[index] >= 'a' && name[index] <= 'z')
        {
            if (name[index] == 'a')
            {
                name[index] = ' ';
            }
            else
            {
                name[index] -= 1;
            }
        }
        else
        {
            name[index] = 'Z';
        }
    }
    else
    {
        if (name[index] >= 'A' && name[index] <= 'Z')
        {
            if (name[index] == 'Z')
            {
                name[index] = ' ';
            }
            else
            {
                name[index] += 1;
            }
        }
        else if (name[index] >= 'a' && name[index] <= 'z')
        {
            if (name[index] == 'z')
            {
                name[index] = 'A';
            }
            else
            {
                name[index] += 1;
            }
        }
        else
        {
            name[index] = 'a';
        }
    }
}

static void disappear()
{
    switch (disappear_step)
    {
    case 1:
        for (uint16_t i = 0; i < buf_len; ++i)
        {
            if (i % 2 == 0)
                buf_ptr[i] = buf_ptr[i] & 0x55;
        }
        break;
    case 2:
        for (uint16_t i = 0; i < buf_len; ++i)
        {
            if (i % 2 != 0)
                buf_ptr[i] = buf_ptr[i] & 0xAA;
        }
        break;
    case 3:
        for (uint16_t i = 0; i < buf_len; ++i)
        {
            if (i % 2 == 0)
                buf_ptr[i] = buf_ptr[i] & 0x00;
        }
        break;
    case 4:
        for (uint16_t i = 0; i < buf_len; ++i)
        {
            if (i % 2 != 0)
                buf_ptr[i] = buf_ptr[i] & 0x00;
        }
        break;
    default:
        ui_state = S_NONE;
        disappear_step = 0;
        break;
    }
    disappear_step++;
}

static void logo_ui_show()
{
    u8g2_DrawXBMP(&u8g2, 0, 0, 128, 64, LOGO);
}

static void select_ui_show()
{
    move_bar(&line_y, &line_y_trg);
    move(&y, &y_trg);
    move(&box_y, &box_y_trg);
    move_width(&box_width, &box_width_trg, ui_select, (BtnUp->currentState == APP_BUTTON_STATE_CLICKED));

    u8g2_DrawVLine(&u8g2, 126, 0, total_line_length);
    u8g2_DrawPixel(&u8g2, 125, 0);
    u8g2_DrawPixel(&u8g2, 127, 0);
    for (uint8_t i = 0; i < list_num; ++i)
    {
        u8g2_DrawStr(&u8g2, x, 16 * i + y + 12, list[i].select);
        u8g2_DrawPixel(&u8g2, 125, single_line_length * (i + 1));
        u8g2_DrawPixel(&u8g2, 127, single_line_length * (i + 1));
    }
    u8g2_DrawVLine(&u8g2, 125, line_y, single_line_length - 1);
    u8g2_DrawVLine(&u8g2, 127, line_y, single_line_length - 1);
    u8g2_SetDrawColor(&u8g2, 2);
    u8g2_DrawRBox(&u8g2, 0, box_y, box_width, 16, 1);
    u8g2_SetDrawColor(&u8g2, 1);
}

void pid_ui_show()
{
    move_bar(&pid_line_y, &pid_line_y_trg);
    move(&pid_box_y, &pid_box_y_trg);
    move_width(&pid_box_width, &pid_box_width_trg, pid_select, (BtnUp->currentState == APP_BUTTON_STATE_CLICKED));
    u8g2_DrawVLine(&u8g2, 126, 0, 61);
    u8g2_DrawPixel(&u8g2, 125, 0);
    u8g2_DrawPixel(&u8g2, 127, 0);
    for (uint8_t i = 0; i < pid_num; ++i)
    {
        u8g2_DrawStr(&u8g2, x, 16 * i + 12, pid[i].select);
        u8g2_DrawPixel(&u8g2, 125, 15 * (i + 1));
        u8g2_DrawPixel(&u8g2, 127, 15 * (i + 1));
    }

    u8g2_SetDrawColor(&u8g2, 2);
    u8g2_DrawRBox(&u8g2, 0, pid_box_y, pid_box_width, 16, 1);
    u8g2_SetDrawColor(&u8g2, 1);
    u8g2_DrawVLine(&u8g2, 125, pid_line_y, 14);
    u8g2_DrawVLine(&u8g2, 127, pid_line_y, 14);
}

void pid_edit_ui_show()
{
    char buf[20];
    u8g2_DrawBox(&u8g2, 16, 16, 96, 31);
    u8g2_SetDrawColor(&u8g2, 2);
    u8g2_DrawBox(&u8g2, 17, 17, 94, 29);
    u8g2_SetDrawColor(&u8g2, 1);

    u8g2_DrawFrame(&u8g2, 18, 36, 60, 8);
    u8g2_DrawBox(&u8g2, 20, 38, (uint8_t)(Kpid[pid_select] / PID_MAX * 56), 4);

    switch (pid_select)
    {
    case 0:
        u8g2_DrawStr(&u8g2, 22, 30, "Editing Kp");
        break;
    case 1:
        u8g2_DrawStr(&u8g2, 22, 30, "Editing Ki");
        break;
    case 2:
        u8g2_DrawStr(&u8g2, 22, 30, "Editing Kd");
        break;
    default:
        break;
    }

    sprintf(buf, "%.2f", Kpid[pid_select]);
    u8g2_DrawStr(&u8g2, 81, 44, buf);
}

void icon_ui_show(void)
{
    move_icon(&icon_x, &icon_x_trg);
    move(&app_y, &app_y_trg);

    for (uint8_t i = 0; i < icon_num; ++i)
    {
        u8g2_DrawXBMP(&u8g2, 46 + icon_x + i * ICON_SPACE, 6, 36, icon_width[i], icon_pic[i]);
        u8g2_SetClipWindow(&u8g2, 0, 48, 128, 64);
        u8g2_DrawStr(&u8g2, (128 - u8g2_GetStrWidth(&u8g2, icon[i].select)) / 2, 62 - app_y + i * 16, icon[i].select);
        u8g2_SetMaxClipWindow(&u8g2);
    }
}

void chart_ui_show()
{
    char buf[20];
    if (!frame_is_drawed)
    {
        u8g2_ClearBuffer(&u8g2);
        chart_draw_frame();
        angle_last = 20.00 + (float)(1024 / 2) / 100.00; // Dummy value
        frame_is_drawed = true;
    }

    u8g2_DrawBox(&u8g2, 96, 0, 30, 14);

    u8g2_DrawVLine(&u8g2, chart_x + 10, 59, 3);
    if (chart_x == 100)
        chart_x = 0;

    u8g2_DrawVLine(&u8g2, chart_x + 11, 24, 34);
    u8g2_DrawVLine(&u8g2, chart_x + 12, 24, 34);
    u8g2_DrawVLine(&u8g2, chart_x + 13, 24, 34);
    u8g2_DrawVLine(&u8g2, chart_x + 14, 24, 34);

    u8g2_SetDrawColor(&u8g2, 2);
    angle = 20.00 + (float)(1024 / 2) / 100.00; // Dummy value
    u8g2_DrawLine(&u8g2, chart_x + 11, 58 - (int)angle_last / 2, chart_x + 12, 58 - (int)angle / 2);
    u8g2_DrawVLine(&u8g2, chart_x + 12, 59, 3);
    angle_last = angle;
    chart_x += 2;
    u8g2_DrawBox(&u8g2, 96, 0, 30, 14);
    u8g2_SetDrawColor(&u8g2, 1);

    sprintf(buf, "%.2f", angle);
    u8g2_DrawStr(&u8g2, 96, 12, buf);
}

void chart_draw_frame()
{
    u8g2_DrawStr(&u8g2, 4, 12, "Real time angle :");
    u8g2_DrawRBox(&u8g2, 4, 18, 120, 46, 8);
    u8g2_SetDrawColor(&u8g2, 2);
    u8g2_DrawHLine(&u8g2, 10, 58, 108);
    u8g2_DrawVLine(&u8g2, 10, 24, 34);
    // Arrow
    u8g2_DrawPixel(&u8g2, 7, 27);
    u8g2_DrawPixel(&u8g2, 8, 26);
    u8g2_DrawPixel(&u8g2, 9, 25);

    u8g2_DrawPixel(&u8g2, 116, 59);
    u8g2_DrawPixel(&u8g2, 115, 60);
    u8g2_DrawPixel(&u8g2, 114, 61);
    u8g2_SetDrawColor(&u8g2, 1);
}

void text_edit_ui_show()
{
    u8g2_DrawRFrame(&u8g2, 4, 6, 120, 52, 8);
    u8g2_DrawStr(&u8g2, (128 - u8g2_GetStrWidth(&u8g2, "--Text Editor--")) / 2, 20, "--Text Editor--");
    u8g2_DrawStr(&u8g2, 10, 38, name);
    u8g2_DrawStr(&u8g2, 80, 50, "-Return");

    uint8_t box_x_calc = 9;

    if (edit_index < name_len)
    {
        if (blink_flag < BLINK_SPEED / 2)
        {
            for (uint8_t i = 0; i < edit_index; ++i)
            {
                char temp[2] = {name[i], '\0'};
                box_x_calc += u8g2_GetStrWidth(&u8g2, temp);
                if (name[i] != ' ')
                {
                    box_x_calc++;
                }
            }
            char temp[2] = {name[edit_index], '\0'};
            u8g2_SetDrawColor(&u8g2, 2);
            u8g2_DrawBox(&u8g2, box_x_calc, 26, u8g2_GetStrWidth(&u8g2, temp) + 2, 16);
            u8g2_SetDrawColor(&u8g2, 1);
        }
    }
    else
    {
        u8g2_SetDrawColor(&u8g2, 2);
        u8g2_DrawRBox(&u8g2, 78, 38, u8g2_GetStrWidth(&u8g2, "-Return") + 4, 16, 1);
        u8g2_SetDrawColor(&u8g2, 1);
    }

    if (edit_flag)
    {
        if (blink_flag < BLINK_SPEED)
        {
            blink_flag += 1;
        }
        else
        {
            blink_flag = 0;
        }
    }
    else
    {
        blink_flag = 0;
    }
}

void about_ui_show()
{
    u8g2_DrawStr(&u8g2, 2, 12, "MCU : ESP32");
    u8g2_DrawStr(&u8g2, 2, 28, "FLASH : 4MB");
    u8g2_DrawStr(&u8g2, 2, 44, "SRAM : 520KB");
    u8g2_DrawStr(&u8g2, 2, 60, "RTC SRAM : 16KB");
}

void logo_proc()
{
    if (BtnOk->currentState == APP_BUTTON_STATE_CLICKED)
    {
        ESP_LOGI(TAG, "OK pressed in LOGO screen, changing to SELECT");
        BtnOk->currentState = APP_BUTTON_STATE_NOCHANGE;
        ui_state = S_DISAPPEAR;
        ui_index = M_SELECT;
    }
    logo_ui_show();
}

void pid_edit_proc(void)
{
    if (BtnUp->currentState == APP_BUTTON_STATE_CLICKED)
    {
        BtnUp->currentState = APP_BUTTON_STATE_NOCHANGE;
        if (Kpid[pid_select] < PID_MAX)
            Kpid[pid_select] += 0.01;
    }
    else if (BtnDown->currentState == APP_BUTTON_STATE_CLICKED)
    {
        BtnDown->currentState = APP_BUTTON_STATE_NOCHANGE;
        if (Kpid[pid_select] > 0)
            Kpid[pid_select] -= 0.01;
    }
    else if (BtnOk->currentState == APP_BUTTON_STATE_CLICKED)
    {
        BtnOk->currentState = APP_BUTTON_STATE_NOCHANGE;
        ui_index = M_PID;
    }

    pid_ui_show();
    for (uint16_t i = 0; i < buf_len; ++i)
    {
        buf_ptr[i] = buf_ptr[i] & (i % 2 == 0 ? 0x55 : 0xAA);
    }
    pid_edit_ui_show();
}

void pid_proc()
{
    pid_ui_show();
    if (BtnUp->currentState == APP_BUTTON_STATE_CLICKED)
    {
        BtnUp->currentState = APP_BUTTON_STATE_NOCHANGE;
        if (pid_select != 0)
        {
            pid_select -= 1;
            pid_line_y_trg -= 15;
            pid_box_y_trg -= 16;
            pid_box_width_trg = u8g2_GetStrWidth(&u8g2, pid[pid_select].select) + x * 2;
        }
    }
    else if (BtnDown->currentState == APP_BUTTON_STATE_CLICKED)
    {
        BtnDown->currentState = APP_BUTTON_STATE_NOCHANGE;
        if (pid_select != 3)
        {
            pid_select += 1;
            pid_line_y_trg += 15;
            pid_box_y_trg += 16;
            pid_box_width_trg = u8g2_GetStrWidth(&u8g2, pid[pid_select].select) + x * 2;
        }
    }
    else if (BtnOk->currentState == APP_BUTTON_STATE_CLICKED)
    {
        BtnOk->currentState = APP_BUTTON_STATE_NOCHANGE;
        if (pid_select == 3)
        {
            ui_index = M_SELECT;
            ui_state = S_DISAPPEAR;
            pid_select = 0;
            pid_line_y = pid_line_y_trg = 1;
            pid_box_y = pid_box_y_trg = 0;
            pid_box_width = pid_box_width_trg = u8g2_GetStrWidth(&u8g2, pid[pid_select].select) + x * 2;
        }
        else
        {
            ui_index = M_PID_EDIT;
        }
    }
}

void select_proc(void)
{
    if (BtnUp->currentState == APP_BUTTON_STATE_CLICKED)
    {
        ESP_LOGI(TAG, "UP pressed in SELECT screen");
        BtnUp->currentState = APP_BUTTON_STATE_NOCHANGE;
        if (ui_select >= 1)
        {
            ui_select -= 1;
            line_y_trg -= single_line_length;
            if (ui_select < -(y / 16))
            {
                y_trg += 16;
            }
            else
            {
                box_y_trg -= 16;
            }
            box_width_trg = u8g2_GetStrWidth(&u8g2, list[ui_select].select) + x * 2;
        }
    }
    else if (BtnDown->currentState == APP_BUTTON_STATE_CLICKED)
    {
        ESP_LOGI(TAG, "DOWN pressed in SELECT screen");
        BtnDown->currentState = APP_BUTTON_STATE_NOCHANGE;
        if ((ui_select + 2) <= list_num)
        {
            ui_select += 1;
            line_y_trg += single_line_length;
            if ((ui_select + 1) > (4 - y / 16))
            {
                y_trg -= 16;
            }
            else
            {
                box_y_trg += 16;
            }
            box_width_trg = u8g2_GetStrWidth(&u8g2, list[ui_select].select) + x * 2;
        }
    }
    else if (BtnOk->currentState == APP_BUTTON_STATE_CLICKED)
    {
        ESP_LOGI(TAG, "OK pressed in SELECT screen, item %d", ui_select);
        BtnOk->currentState = APP_BUTTON_STATE_NOCHANGE;
        switch (ui_select)
        {
        case 0: // return
            ui_state = S_DISAPPEAR;
            ui_index = M_LOGO;
            break;
        case 1: // pid
            ui_state = S_DISAPPEAR;
            ui_index = M_PID;
            break;
        case 2: // icon
            ui_state = S_DISAPPEAR;
            ui_index = M_ICON;
            break;
        case 3: // chart
            ui_state = S_DISAPPEAR;
            ui_index = M_CHART;
            break;
        case 4: // textedit
            ui_state = S_DISAPPEAR;
            ui_index = M_TEXT_EDIT;
            break;
        case 6: // about
            ui_state = S_DISAPPEAR;
            ui_index = M_ABOUT;
            break;
        default:
            break;
        }
    }
    select_ui_show();
}

void icon_proc(void)
{
    icon_ui_show();
    if (BtnLeft->currentState == APP_BUTTON_STATE_CLICKED)
    {
        BtnLeft->currentState = APP_BUTTON_STATE_NOCHANGE;
        if (icon_select != 0)
        {
            icon_select -= 1;
            app_y_trg -= 16;
            icon_x_trg += ICON_SPACE;
        }
    }
    else if (BtnRight->currentState == APP_BUTTON_STATE_CLICKED)
    {
        BtnRight->currentState = APP_BUTTON_STATE_NOCHANGE;
        if (icon_select != (icon_num - 1))
        {
            icon_select += 1;
            app_y_trg += 16;
            icon_x_trg -= ICON_SPACE;
        }
    }
    else if (BtnOk->currentState == APP_BUTTON_STATE_CLICKED)
    {
        BtnOk->currentState = APP_BUTTON_STATE_NOCHANGE;
        ui_state = S_DISAPPEAR;
        ui_index = M_SELECT;
        icon_select = 0;
        icon_x = icon_x_trg = 0;
        app_y = app_y_trg = 0;
    }
}

void chart_proc()
{
    chart_ui_show();
    if (BtnOk->currentState == APP_BUTTON_STATE_CLICKED)
    {
        BtnOk->currentState = APP_BUTTON_STATE_NOCHANGE;
        ui_state = S_DISAPPEAR;
        ui_index = M_SELECT;
        frame_is_drawed = false;
        chart_x = 0;
    }
}

void text_edit_proc()
{
    text_edit_ui_show();
    if (BtnLeft->currentState == APP_BUTTON_STATE_CLICKED)
    {
        BtnLeft->currentState = APP_BUTTON_STATE_NOCHANGE;
        if (edit_flag)
        {
            text_edit(false, edit_index);
        }
        else
        {
            if (edit_index == 0)
            {
                edit_index = name_len;
            }
            else
            {
                edit_index -= 1;
            }
        }
    }
    else if (BtnRight->currentState == APP_BUTTON_STATE_CLICKED)
    {
        BtnRight->currentState = APP_BUTTON_STATE_NOCHANGE;
        if (edit_flag)
        {
            text_edit(true, edit_index);
        }
        else
        {
            if (edit_index == name_len)
            {
                edit_index = 0;
            }
            else
            {
                edit_index += 1;
            }
        }
    }
    else if (BtnOk->currentState == APP_BUTTON_STATE_CLICKED)
    {
        BtnOk->currentState = APP_BUTTON_STATE_NOCHANGE;
        if (edit_index == name_len)
        {
            ui_state = S_DISAPPEAR;
            ui_index = M_SELECT;
            edit_index = 0;
        }
        else
        {
            edit_flag = !edit_flag;
        }
    }
}

void about_proc()
{
    if (BtnOk->currentState == APP_BUTTON_STATE_CLICKED)
    {
        BtnOk->currentState = APP_BUTTON_STATE_NOCHANGE;
        ui_state = S_DISAPPEAR;
        ui_index = M_SELECT;
    }
    about_ui_show();
}

void ui_proc()
{
    switch (ui_state)
    {
    case S_NONE:
        if (ui_index != M_CHART)
            u8g2_ClearBuffer(&u8g2);
        switch (ui_index)
        {
        case M_LOGO:
            logo_proc();
            break;
        case M_SELECT:
            select_proc();
            break;
        case M_PID:
            pid_proc();
            break;
        case M_ICON:
            icon_proc();
            break;
        case M_CHART:
            chart_proc();
            break;
        case M_TEXT_EDIT:
            text_edit_proc();
            break;
        case M_PID_EDIT:
            pid_edit_proc();
            break;
        case M_ABOUT:
            about_proc();
            break;
        default:
            break;
        }
        break;
    case S_DISAPPEAR:
        disappear();
        break;
    default:
        break;
    }
    u8g2_SendBuffer(&u8g2);
}

void ui_init(void)
{
    ESP_LOGI(TAG, "UI Init");
    u8g2_SetFont(&u8g2, u8g2_font_wqy12_t_gb2312); // A font that supports Chinese
    
    buf_ptr = u8g2_GetBufferPtr(&u8g2);
    buf_len = 8 * u8g2_GetBufferTileHeight(&u8g2) * u8g2_GetBufferTileWidth(&u8g2);

    single_line_length = 63 / list_num;
    total_line_length = single_line_length * list_num + 1;

    x = 4;
    y = y_trg = 0;
    line_y = line_y_trg = 1;
    pid_line_y = pid_line_y_trg = 1;
    ui_select = pid_select = icon_select = 0;
    icon_x = icon_x_trg = 0;
    app_y = app_y_trg = 0;

    box_width = box_width_trg = u8g2_GetStrWidth(&u8g2, list[ui_select].select) + x * 2;
    pid_box_width = pid_box_width_trg = u8g2_GetStrWidth(&u8g2, pid[pid_select].select) + x * 2;

    ui_index = M_LOGO;
    ui_state = S_NONE;
    ESP_LOGI(TAG, "UI Init Done");
}

void ui_task(void *pvParameters)
{
    while (1)
    {
        ui_proc();           // Process UI and input events
        vTaskDelay(pdMS_TO_TICKS(10)); // UI update rate
    }
}